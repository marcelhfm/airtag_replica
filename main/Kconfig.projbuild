## main/Kconfig.projbuild
```kconfig
menu "Irrigation Configuration"

config WIFI_MAX_RETRIES 
  int "WiFi Max Retries attempts"
  default 5
  help
      Enter the maximum number of retries to connect to WiFi

config FIRMWARE_URL
  string "Firmware url"
  default "https://github.com/marcelhfm/irrigation/releases/latest/download/irrigation.bin"
  help
      Enter the firmware url where the binary is uploaded to

config FIRMWARE_VERSION_URL
  string "Firmware url"
  default "https://api.github.com/repos/marcelhfm/irrigation/releases/latest"
  help
      Enter the firmware url where the binary is uploaded to

config HOME_SERVER_IP
  string "Home server IP"
  default "192.168.11.30"
  help
      Enter the ip address of the server running in the same network

config HOME_SERVER_UDP_PORT
  int "UDP Port"
  default 12345
  help
      Enter the UDP port of the home server

config HOME_SERVER_MQTT_URI
  string "MQTT Broker URI"
  default "mqtt://192.168.11.30:1883"
  help
      Enter the MQTT Broker URI

endmenu
```
